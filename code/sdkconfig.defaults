## code/sdkconfig.defaults
```kconfig
CONFIG_ESP_MAIN_TASK_STACK_SIZE=50000
CONFIG_PTHREAD_TASK_STACK_SIZE_DEFAULT=30000
CONFIG_LWIP_SNTP_MAX_SERVERS=4
CONFIG_LOG_DEFAULT_LEVEL_INFO=y
CONFIG_PARTITION_TABLE_SINGLE_APP_LARGE=y
```
